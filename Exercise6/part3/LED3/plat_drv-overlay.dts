/dts-v1/;  /* Device Tree version */
/plugin/;  /* Declare plugin usage */

/  {
    compatible = "brcm,bcm2835", "brcm,bcm2836", "brcm,bcm2708", "brcm,bcm2709";  /* Device compatibility */

    fragment@0 {
        /* Add device to base */
        target-path = "/";
        __overlay__ {
            /* instance:type */
            plat_drv: plat_drv@0 {
                /* Label to match in driver */
                compatible = "ase, led3";  /* Compatible string for the driver */
                status = "okay";  /* Set status to enabled */
                /* Configure gpio module */
                /* <resource pinno dir pinno dir pinno dir ....> */
                gpios = <&gpio 12 0>, <&gpio 16 0>, <&gpio 20 1>, <&gpio 21 1>, <&gpio 26 1>;  /* GPIO pin configuration */

                /* Custom Property */
                /* <32-bit int value> */
                mydevt-custom = <0x12345678>;  /* Custom property value */
            };
        };
    };
};